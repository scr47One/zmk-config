## config/west.yml
```yaml
manifest:
  remotes:
    - name: scr47One
      url-base: https://github.com/scr47One
  projects:
    - name: zmk
      remote: scr47One
      revision: pr/1243
      import: app/west.yml
  self:
    path: config
```
